## Kconfig
```kconfig
config ZMK_RUNTIME_COMBO
    bool "Enable runtime combo"
    depends on !ZMK_SPLIT || ZMK_SPLIT_ROLE_CENTRAL
    select SETTINGS
    select ZMK_CUSTOM_SETTINGS
    select ZMK_BEHAVIOR_LOCAL_IDS
    help
      Enable combos that can be changed at runtime through the custom Studio RPC
      subsystem. Like ZMK's own combos they resolve on the central, which
      receives every position.

if ZMK_RUNTIME_COMBO

config ZMK_RUNTIME_COMBO_STUDIO_RPC
    bool "Enable runtime combo custom Studio RPC"
    depends on ZMK_STUDIO
    select ZMK_CUSTOM_SETTINGS_STUDIO_RPC

config ZMK_RUNTIME_COMBO_MAX_COMBOS
    int "Maximum runtime combos"
    default 8
    range 1 16
    help
      Each slot holds a decoded copy in a RAM cache used on the key-event hot
      path, roughly 64 bytes per slot. The Studio list response carries at
      most 16 combos, which bounds this.

config ZMK_RUNTIME_COMBO_MAX_POSITIONS_PER_COMBO
    int "Maximum positions per runtime combo"
    default 16
    range 2 16

config ZMK_RUNTIME_COMBO_DEFAULT_TIMEOUT_MS
    int "Default runtime combo timeout"
    default 50
    range 1 65535

config ZMK_RUNTIME_COMBO_DEFAULT_REQUIRE_PRIOR_IDLE_MS
    int "Default runtime combo require-prior-idle time"
    default 0
    range 0 65535
    help
      A combo's positions are ignored if a non-modifier key was tapped within
      this many milliseconds before the combo's first key press. 0 disables
      this guard.

config ZMK_RUNTIME_COMBO_TEST
    bool "Enable runtime combo self-test setup"
    help
      Owner zmk-test fixtures only. The setup overwrites combo slots on the
      first key event; never enable it in a keyboard build.

config ZMK_RUNTIME_COMBO_TEST_DISCARD
    bool "Exercise zmk_runtime_combo_invalidate_cache() in the self-test setup"
    depends on ZMK_RUNTIME_COMBO_TEST

endif

config ZMK_RUNTIME_COMBO_FORK_LOG_LEVEL
    int "zmk-runtime-combo-fork log level (0 off, 1 error, 2 warning, 3 info, 4 debug)"
    range 0 4
    default 3
    help
      Logs contain operational state and numeric diagnostics, never input
      contents, user labels, peer addresses or authentication material.
```

## dts/bindings/cormoran,runtime-combo-defaults.yaml
```yaml
# Copyright (c) 2026 cormoran
#
# SPDX-License-Identifier: MIT

description: |
  Compile-time defaults for zmk-feature-runtime-combo. Each child node
  configures one runtime combo slot; the slot behaves exactly as if the same
  values had been written through the custom Studio RPC, but is active
  immediately after flashing and survives a settings erase. A slot with a
  stored runtime value (written or explicitly deleted through the RPC) always
  overrides its default.

compatible: "cormoran,runtime-combo-defaults"

child-binding:
  description: A single default runtime combo.

  properties:
    key-positions:
      type: array
      required: true
      description: |
        Key positions that make up the combo, same as zmk,combos. Every raw
        cell must be in 0..65535 before conversion to the runtime uint16 cache.
    bindings:
      type: phandle-array
      required: true
      description: The single behavior binding invoked when the combo fires.
    layers:
      type: array
      description: |
        Layers the combo is active on. Every raw cell must be in 0..31, the
        width of the runtime layer mask. Omit for all layers.
    slow-release:
      type: boolean
      description: Overrides the global slow-release setting to "on" for this combo.
    timeout-ms:
      type: int
      description: |
        Overrides the global combo timeout for this combo, in 0..65535 ms.
        Omit or set zero to inherit. Checked before uint16 conversion.
    require-prior-idle-ms:
      type: int
      description: |
        Overrides the global require-prior-idle setting for this combo, in
        0..65535 ms. Omit or set zero to inherit. Checked before uint16 conversion.
    slot:
      type: int
      description: Runtime combo slot index. Defaults to the node's definition order.
    display-name:
      type: string
      description: Display name shown in the Web UI. Defaults to the node name.
```

## tests/stack-budget/module/dts/bindings/kscan/amgskobo,combo-stack-kscan.yaml
```yaml
description: Inert test-only Kscan device for direct event stack measurements
compatible: "amgskobo,combo-stack-kscan"
include: base.yaml
properties:
  rows:
    type: int
    required: true
  columns:
    type: int
    required: true
```
